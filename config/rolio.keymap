/*
 * Copyright (c) 2020 The ZMK Contributors
 *
 * SPDX-License-Identifier: MIT
 */

/* Upgrayeddedd's Rolio46 keymap
 * Based on MickiusMousius's original keymap
 * Added urob's helpers etc
 * Many changes because I use a Finnish layout
 * Just a work in progress of many ideas, but quite well sorted for now
 */

#include <behaviors.dtsi>
#include <dt-bindings/zmk/backlight.h>
#include <dt-bindings/zmk/bt.h>
#include <dt-bindings/zmk/keys.h>
#include <dt-bindings/zmk/outputs.h>

#define ZMK_POINTING_DEFAULT_MOVE_VAL 1500
#define ZMK_POINTING_DEFAULT_SCRL_VAL 100
#include <dt-bindings/zmk/pointing.h>

/* urob's helpers */
#include <zmk-helpers/helper.h>

/* Key labels */
#include <zmk-helpers/key-labels/rolio46.h>

// Elpekenin's zmk-userspace behaviors
// TODO: Removed for now, see below
//#include "elpekenin/behaviors.dtsi"

/* Finnish layout */
#include "include/finnish_layout.h"

/* String input */
// Experimental, just for me so far
// TODO can I find this out from DT in here?
#define STRING_INPUT_MODULE
#ifdef STRING_INPUT_MODULE
#define ZMK_BEHAVIOR_CORE_string_input compatible = "zmk,behavior-string-input"; #binding-cells = <0>
#define ZMK_STRING_INPUT(NAME, ACCEPT, CANCEL, ...) ZMK_BEHAVIOR(NAME, string_input, bindings = <ACCEPT>, <CANCEL>; __VA_ARGS__)
#endif

/* String display */
// Experimental, just for me so far
// TODO can I find this out from DT in here?
#define STRING_DISPLAY_MODULE
#ifdef STRING_DISPLAY_MODULE
#include <zmk-behavior-string-display/string-display.h>
#define ZMK_BEHAVIOR_CORE_string_display compatible = "zmk,behavior-string-display"; #binding-cells = <2>
#define ZMK_STRING_DISPLAY(NAME, ...) ZMK_BEHAVIOR(NAME, string_display, __VA_ARGS__)
#endif

// My helpers
#include "include/helpers.h"

/* Layer indices (needed by combos etc) */

#define ALPHA     0
#define ALPSYM    1
#define GAME      2
#define GAME_X    3
#define FN_NAV    4
#define NUMPAD    5
#define SYMBOL    6
#define MEDIA     7
#define SUDOKU    8
#define CONFIG    9

/* broken out into separate files */
#include "dtsi/behavior_defaults.dtsi"
#include "dtsi/sensors.dtsi"
#include "dtsi/tapdances.dtsi"
#include "dtsi/altgr_extras.dtsi"
#include "dtsi/homerowmods.dtsi"
#include "dtsi/holdtaps.dtsi"
#include "dtsi/macros.dtsi"
#include "dtsi/mouse.dtsi"
#include "dtsi/layers.dtsi"
#include "dtsi/combos.dtsi"
#include "dtsi/leader.dtsi"
