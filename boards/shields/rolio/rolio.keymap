/*
 * Copyright (c) 2020 The ZMK Contributors
 *
 * SPDX-License-Identifier: MIT
 */

/* Upgrayeddedd's Rolio46 keymap
 * Based on MickiusMousius's original keymap
 * Added urob's helpers etc
 * Many changes because I use a Finnish layout
 * Just a work in progress of many ideas, but quite well sorted for now
 */

#include <behaviors.dtsi>
#include <dt-bindings/zmk/backlight.h>
#include <dt-bindings/zmk/bt.h>
#include <dt-bindings/zmk/keys.h>
#include <dt-bindings/zmk/outputs.h>

#define ZMK_POINTING_DEFAULT_MOVE_VAL 1500
#define ZMK_POINTING_DEFAULT_SCRL_VAL 100
#include <dt-bindings/zmk/pointing.h>

/* urob's helpers */
#include <zmk-helpers/helper.h>

// Elpekenin's zmk-userspace behaviors
// TODO: Removed for now, see below
//#include "elpekenin/behaviors.dtsi"

/* Finnish layout */
#include "finnish.h"

/* String input */
// Experimental, just for me so far
// TODO can I find this out from DT in here?
//#define STRING_INPUT_MODULE
#ifdef STRING_INPUT_MODULE
#define ZMK_BEHAVIOR_CORE_string_input compatible = "zmk,behavior-string-input"; #binding-cells = <0>
#define ZMK_STRING_INPUT(NAME, ACCEPT, CANCEL, ...) ZMK_BEHAVIOR(NAME, string_input, bindings = <ACCEPT>, <CANCEL>; __VA_ARGS__)
#endif

// My helpers
#include "helpers.h"

/* Layer indices (needed by combos etc) */

#define ALPHA     0
#define ALPSYM    1
#define GAME      2
#define GAME_X    3
#define FN_NAV    4
#define NUMPAD    5
#define SYMBOL    6
#define MEDIA     7
#define SUDOKU    8
#define CONFIG    9

/* broken out into separate files */
#include "behavior_defaults.dtsi"
#include "sensors.dtsi"
#include "tapdances.dtsi"
#include "holdtaps.dtsi"
#include "macros.dtsi"
#include "altgr_extras.dtsi"
#include "mouse.dtsi"
#include "layers.dtsi"
#include "combos.dtsi"
#include "leader.dtsi"
