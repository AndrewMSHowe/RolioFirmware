## boards/shields/rolio/Kconfig.defconfig
```kconfig
if SHIELD_ROLIO_LEFT

config ZMK_KEYBOARD_NAME
    default "Rolio46"

config ZMK_SPLIT_ROLE_CENTRAL
    default y

config BT_MAX_CONN
    default 11
config BT_MAX_PAIRED
    default 11

endif

if SHIELD_ROLIO_LEFT || SHIELD_ROLIO_RIGHT

config ZMK_SPLIT
    default y

endif

if ZMK_BACKLIGHT

config PWM
    default y

config LED_PWM
    default y

endif # ZMK_BACKLIGHT
```

## config/west.yml
```yaml
manifest:
  remotes:
    - name: zmkfirmware
      url-base: https://github.com/zmkfirmware
    - name: elpekenin
      url-base: https://github.com/elpekenin
    - name: urob
      url-base: https://github.com/urob
    - name: joelspadin
      url-base: https://github.com/joelspadin
    - name: AndrewMSHowe
      url-base: https://github.com/AndrewMSHowe
  projects:
    - name: zmk
      import: app/west.yml
      remote: zmkfirmware
      revision: e93cd31a5866cd4f50385bece7a3fb770f2ca6f8
    - name: zmk-userspace
      remote: elpekenin
      revision: main
    - name: zmk-helpers
      remote: urob
      revision: main
    - name: zmk-leader-key
      remote: urob
      revision: v0.2.1
    - name: zmk-locales
      remote: joelspadin
      revision: main
  self:
    path: config
```
